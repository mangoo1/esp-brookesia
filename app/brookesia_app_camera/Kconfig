## app/brookesia_app_camera/Kconfig
```kconfig
menu "ESP-Brookesia: Camera App Configurations"
    config BROOKESIA_APP_CAMERA_ENABLE_PRELOAD_DOM
        bool "Preload Camera GUI DOM"
        default y
        help
            Preload and retain the Camera app GUI DOM when the app is installed.
            This moves JSON UI parse/load cost out of the user-visible launch path
            at the cost of extra resident PSRAM.
endmenu
```

## app/brookesia_app_ess/Kconfig
```kconfig
menu "ESP-Brookesia: ESS App Configurations"
    config BROOKESIA_APP_ESS_ENABLE_PRELOAD_DOM
        bool "Preload ESS GUI DOM"
        default y
        help
            Preload and retain the ESS app GUI DOM when the app is installed.
endmenu
```
